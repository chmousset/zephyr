## boards/mangopi/mq1w/Kconfig.mangopi_mq1w
```kconfig
# Copyright (c) 2025
# SPDX-License-Identifier: Apache-2.0

config BOARD_MANGOPI_MQ1W
	select SOC_ALLWINNER_D1S
```

## boards/mangopi/mq1w/board.yml
```yaml
board:
  name: mangopi_mq1w
  full_name: MangoPi MQ1W
  vendor: widora
  socs:
    - name: d1s
```

## drivers/clock_control/Kconfig.sun20i_d1
```kconfig
# Copyright (c) 2025
# SPDX-License-Identifier: Apache-2.0

config CLOCK_CONTROL_SUN20I_D1
	bool "Allwinner D1s/F133 CCU driver"
	depends on DT_HAS_ALLWINNER_SUN20I_D1_CCU
	help
	  Enable the Clock Control Unit (CCU) driver for Allwinner D1s/F133.
```

## drivers/flash/Kconfig.spi_nand
```kconfig
# SPI NAND flash configuration options

# Copyright (c) 2025
# SPDX-License-Identifier: Apache-2.0

menuconfig SPI_NAND
	bool "SPI NAND Flash"
	default y
	depends on DT_HAS_JEDEC_SPI_NAND_ENABLED
	select FLASH_HAS_DRIVER_ENABLED
	select FLASH_HAS_EXPLICIT_ERASE
	select FLASH_HAS_PAGE_LAYOUT
	select SPI
	help
	  Enable the SPI NAND flash driver using a JEDEC-style command set.
```

## drivers/gpio/Kconfig.sun20i_d1
```kconfig
# Allwinner sun20i D1 GPIO configuration options

# Copyright (c) 2025
# SPDX-License-Identifier: Apache-2.0

config GPIO_SUN20I_D1
	bool "Allwinner sun20i D1 GPIO driver"
	default y
	depends on DT_HAS_ALLWINNER_SUN20I_D1_GPIO_ENABLED
	help
	  Enable the GPIO driver for the sun20i D1 PIO block used by
	  Allwinner D1/D1s (F133) SoCs.
```

## drivers/i2c/Kconfig.sun6i
```kconfig
# Allwinner sun6i I2C configuration options

# Copyright (c) 2025
# SPDX-License-Identifier: Apache-2.0

config I2C_SUN6I
	bool "Allwinner sun6i TWI (I2C) driver"
	default y
	depends on DT_HAS_ALLWINNER_SUN20I_D1_I2C_ENABLED
	select PINCTRL
	help
	  Enable the sun6i-style TWI controller driver used by
	  Allwinner D1/D1s (F133) SoCs.
```

## drivers/pinctrl/Kconfig.allwinner_d1
```kconfig
# Copyright (c) 2025
# SPDX-License-Identifier: Apache-2.0

config PINCTRL_ALLWINNER_D1
	bool "Allwinner D1s/F133 pinctrl driver"
	depends on DT_HAS_ALLWINNER_SUN20I_D1_PINCTRL
	select PINCTRL_STORE_REG
	help
	  Enable pinctrl driver for the Allwinner D1s/F133 PIO controller.
```

## drivers/pwm/Kconfig.sun20i_d1
```kconfig
# Allwinner sun20i D1 PWM configuration options

# Copyright (c) 2025
# SPDX-License-Identifier: Apache-2.0

config PWM_SUN20I_D1
	bool "Allwinner sun20i D1 PWM driver"
	default y
	depends on DT_HAS_ALLWINNER_SUN20I_D1_PWM_ENABLED
	select PINCTRL
	help
	  Enable the PWM driver for the sun20i D1 PWM block used by
	  Allwinner D1/D1s (F133) SoCs.
```

## drivers/spi/Kconfig.sun6i
```kconfig
# Allwinner sun6i SPI configuration options

# Copyright (c) 2025
# SPDX-License-Identifier: Apache-2.0

config SPI_SUN6I
	bool "Allwinner sun6i SPI driver"
	default y
	depends on DT_HAS_ALLWINNER_SUN20I_D1_SPI_ENABLED
	select PINCTRL
	help
	  Enable the sun6i-style SPI controller driver used by
	  Allwinner D1/D1s (F133) SoCs.
```

## drivers/timer/Kconfig.sun20i_d1
```kconfig
# Copyright (c) 2025
# SPDX-License-Identifier: Apache-2.0

config SUN20I_D1_TIMER
	bool "Allwinner D1s timer"
	default y
	depends on DT_HAS_ALLWINNER_SUN20I_D1_TIMER_ENABLED
```

## dts/bindings/clock/allwinner,sun20i-d1-ccu.yaml
```yaml
# Copyright (c) 2025
# SPDX-License-Identifier: Apache-2.0

description: Allwinner D1s/F133 Clock Control Unit

compatible: "allwinner,sun20i-d1-ccu"

include: base.yaml

properties:
  reg:
    required: true

  "#clock-cells":
    type: int
    const: 1

  clock-frequency:
    type: int
    description: Input oscillator rate in Hz (HOSC).

clock-cells:
  - clkid
```

## dts/bindings/gpio/allwinner,sun20i-d1-gpio.yaml
```yaml
# Copyright (c) 2025
# SPDX-License-Identifier: Apache-2.0

description: Allwinner D1s/F133 GPIO port controller

compatible: "allwinner,sun20i-d1-gpio"

include: [gpio-controller.yaml, base.yaml]

properties:
  reg:
    required: true

  "#gpio-cells":
    const: 2

gpio-cells:
  - pin
  - flags
```

## dts/bindings/i2c/allwinner,sun20i-d1-i2c.yaml
```yaml
# Copyright (c) 2025
# SPDX-License-Identifier: Apache-2.0

description: Allwinner D1s/F133 TWI (I2C) controller

compatible: "allwinner,sun20i-d1-i2c"

include: [i2c-controller.yaml, pinctrl-device.yaml]

properties:
  reg:
    required: true

  clocks:
    type: phandle-array
    description: Bus clock gate/reset for the TWI controller.
```

## dts/bindings/mtd/jedec,spi-nand.yaml
```yaml
# Copyright (c) 2025
# SPDX-License-Identifier: Apache-2.0

description: |
  SPI NAND flash device with a JEDEC-style command set.

compatible: "jedec,spi-nand"

include: spi-device.yaml

properties:
  page-size:
    type: int
    required: true
    description: Page size in bytes.

  pages-per-block:
    type: int
    required: true
    description: Number of pages per erase block.

  block-count:
    type: int
    required: true
    description: Number of erase blocks on the device.
```

## dts/bindings/pinctrl/allwinner,sun20i-d1-pinctrl.yaml
```yaml
# Copyright (c) 2025
# SPDX-License-Identifier: Apache-2.0

description: Allwinner D1s/F133 PIO pin controller

compatible: "allwinner,sun20i-d1-pinctrl"

include: base.yaml

properties:
  reg:
    required: true

child-binding:
  description: |
    Allwinner D1s/F133 pin configuration.

  include:
    - name: pincfg-node.yaml
      property-allowlist:
        - bias-disable
        - bias-pull-down
        - bias-pull-up
        - drive-strength

  properties:
    pinmux:
      required: true
      type: int
      description: |
        Encodes the port, pin, and function select value.
        Use the ALLWINNER_D1_PINMUX() macro in
        include/zephyr/dt-bindings/pinctrl/allwinner-d1-pinctrl.h.
    drive-strength:
      type: int
      enum: [0, 1, 2, 3, 4, 5, 6, 7, 8, 9, 10, 11, 12, 13, 14, 15]
      description: |
        Drive strength level (0..15). The SoC uses 4-bit drive selection.
```

## dts/bindings/pwm/allwinner,sun20i-d1-pwm.yaml
```yaml
# Copyright (c) 2025
# SPDX-License-Identifier: Apache-2.0

description: Allwinner D1s/F133 PWM controller

compatible: "allwinner,sun20i-d1-pwm"

include: [pwm-controller.yaml, pinctrl-device.yaml]

properties:
  reg:
    type: array
    required: true

  clocks:
    type: phandle-array
    description: Bus clock gate/reset for the PWM controller.

  "#pwm-cells":
    type: int
    const: 3

pwm-cells:
  - channel
  - period
  - flags
```

## dts/bindings/spi/allwinner,sun20i-d1-spi.yaml
```yaml
# Copyright (c) 2025
# SPDX-License-Identifier: Apache-2.0

description: Allwinner D1s/F133 SPI controller

compatible: "allwinner,sun20i-d1-spi"

include: [spi-controller.yaml, pinctrl-device.yaml]

properties:
  reg:
    required: true

  clocks:
    type: phandle-array
    description: Bus clock gate/reset for the SPI controller.
```

## dts/bindings/timer/allwinner,sun20i-d1-timer.yaml
```yaml
# Copyright (c) 2025
# SPDX-License-Identifier: Apache-2.0

description: Allwinner D1s/F133 timer

compatible: "allwinner,sun20i-d1-timer"

include: base.yaml

properties:
  reg:
    type: array
    required: true

  interrupts:
    required: true

  clocks:
    type: phandle-array
```

## soc/allwinner/common/Kconfig.zephyr
```kconfig
# SPDX-License-Identifier: Apache-2.0

config SUNXI_EGON_HEADER
	bool "Embed sunxi eGON.BT0 header"
	default y if SOC_ALLWINNER_D1S || SOC_SUN8I_H3
	depends on SOC_ALLWINNER_D1S || SOC_SUN8I_H3
	help
	  Embed a minimal eGON.BT0 header at the start of the image. The
	  header is patched post-build with length and checksum, allowing
	  direct flash boot while still supporting SRAM loading.

	  Documentation:
	    - doc/hardware/soc/allwinner/egon_header.rst
	    - https://linux-sunxi.org/BROM
	    - https://linux-sunxi.org/EGON
```

## soc/allwinner/d1s/Kconfig
```kconfig
# Copyright (c) 2025
# SPDX-License-Identifier: Apache-2.0

config SOC_SERIES_ALLWINNER_D1
	bool
	select RISCV
	select RISCV_PRIVILEGED
	select RISCV_HAS_PLIC
	select RISCV_SOC_HAS_GP_RELATIVE_ADDRESSING

config SOC_ALLWINNER_D1S
	bool
	select SOC_SERIES_ALLWINNER_D1
	select INCLUDE_RESET_VECTOR
	select RISCV_ISA_RV64I
	select RISCV_ISA_EXT_M
	select RISCV_ISA_EXT_A
	select RISCV_ISA_EXT_C
	select RISCV_ISA_EXT_ZICSR
	select RISCV_ISA_EXT_ZIFENCEI

config SOC_ALLWINNER_D1S_DDR_INIT
	bool "Initialize D1s DRAM controller"
	default y
	depends on SOC_ALLWINNER_D1S
	help
	  Enable the early DRAM initialization hook for Allwinner D1s/F133.

source "soc/allwinner/common/Kconfig.zephyr"
```

## soc/allwinner/d1s/Kconfig.defconfig
```kconfig
# Copyright (c) 2025
# SPDX-License-Identifier: Apache-2.0

if SOC_ALLWINNER_D1S

config SYS_CLOCK_HW_CYCLES_PER_SEC
	default 24000000

config CLOCK_CONTROL
	default y

config PINCTRL
	default y

config RISCV_SOC_INTERRUPT_INIT
	default y

config 2ND_LVL_ISR_TBL_OFFSET
	default 12

config 2ND_LVL_INTR_00_OFFSET
	default 11

config MAX_IRQ_PER_AGGREGATOR
	default 175

config NUM_IRQS
	default 187

config MULTI_LEVEL_INTERRUPTS
	default y

config 2ND_LEVEL_INTERRUPTS
	default y

config NUM_2ND_LEVEL_AGGREGATORS
	default 1

config PLIC
	default y

config PINCTRL_SUN20I_D1
	default y

config CLOCK_CONTROL_SUN20I_D1
	default y

config SUN20I_D1_TIMER
	default y

if SERIAL

config UART_NS16550
	default y

config UART_NS16550_DW8250_DW_APB
	default y

config UART_NS16550_ACCESS_WORD_ONLY
	default y

endif # SERIAL

endif
```

## soc/allwinner/d1s/Kconfig.soc
```kconfig
# Copyright (c) 2025
# SPDX-License-Identifier: Apache-2.0

config SOC_SERIES_ALLWINNER_SUN20I
	bool
	help
	  Allwinner sun20i series

config SOC_ALLWINNER_D1S
	bool
	select SOC_SERIES_ALLWINNER_SUN20I
	help
	  Allwinner D1s/F133

config SOC_SERIES
	default "sun20i" if SOC_SERIES_ALLWINNER_SUN20I

config SOC
	default "d1s" if SOC_ALLWINNER_D1S
```
